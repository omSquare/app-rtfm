## Kconfig
```kconfig
mainmenu "rtfm: Radio Test Field Measurement"

# Your application configuration options go here
source "$(ZENOS_BASE)/Kconfig"
```

## boards/arm/stm32_10g_primer/Kconfig.board
```kconfig
# Kconfig - STM32 MINI A15 board configuration
#
# Copyright (c) 2016 Open-RnD Sp. z o.o.
#
# SPDX-License-Identifier: Apache-2.0
#

config BOARD_STM32_10G_PRIMER
	bool "STM32 10G PRIMER Development Board"
	depends on SOC_STM32F103XE
	select USB_DC_STM32_DISCONN_ENABLE if USB
```

## boards/arm/stm32_10g_primer/Kconfig.defconfig
```kconfig
# Kconfig - STM32 MINI A15 board configuration
#
# Copyright (c) 2016 Open-RnD Sp. z o.o.
#
# SPDX-License-Identifier: Apache-2.0
#

if BOARD_STM32_10G_PRIMER

config BOARD
	default "stm32_10g_primer"

if UART_CONSOLE

config UART_STM32_PORT_1
	default y

endif # UART_CONSOLE

endif # BOARD_STM32_10G_PRIMER
```
